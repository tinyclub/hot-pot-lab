## drivers/block/Kconfig
```kconfig
menu "block drivers"

config SD
	bool "sd supports"
	default n
	help
	  Say Y here to support sd.

endmenu
```

## drivers/char/Kconfig
```kconfig
menu "char drivers"

config TTY
	bool "tty supports"
	default n
	help
	  Say Y here to support tty.

endmenu
```

## fs/Kconfig
```kconfig
menu "file system"

config PROC_FS
	def_bool y
	help
	  Say Y here to include the proc file system.
	 
config MSDOS_FS
	def_bool y
	help
	  Say Y here to include the msdos file system.

config UMSDOS_FS
	bool "umsdos filesystem"
	default n
	help
	  Say Y here to include the umsdos file system.
	  
config EXT2_FS
	def_bool y
	help
	  Say Y here to include the ext2 file system.
#source "fs/yaffs2/Kconfig"
endmenu
```

## lib/Kconfig.debug
```kconfig
config DEBUG_KERNEL
	bool "Kernel debugging"
	help
	  Say Y here if you are developing drivers or trying to debug and
	  identify kernel problems.
```

## net/Kconfig
```kconfig
#
# Network configuration
#

menuconfig NET
	bool "Networking support"
	select NLATTR
	select GENERIC_NET_UTILS
	select BPF
	---help---
	  Unless you really know what you are doing, you should say Y here.
	  The reason is that some programs need kernel networking support even
	  when running on a stand-alone machine that isn't connected to any
	  other computer.
	  
	  If you are upgrading from an older kernel, you
	  should consider updating your networking tools too because changes
	  in the kernel and the tools often go hand in hand. The tools are
	  contained in the package net-tools, the location and version number
	  of which are given in <file:Documentation/Changes>.

	  For a general introduction to Linux networking, it is highly
	  recommended to read the NET-HOWTO, available from
	  <http://www.tldp.org/docs.html#howto>.
```
