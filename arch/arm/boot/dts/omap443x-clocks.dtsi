/*
 * Device Tree Source for OMAP443x clock data
 *
 * Copyright (C) 2013 Texas Instruments, Inc.
 *
 * This program is free software; you can redistribute it and/or modify
 * it under the terms of the GNU General Public License version 2 as
 * published by the Free Software Foundation.
 */

bandgap_fclk: bandgap_fclk@4a307888 {
	#clock-cells = <0>;
	compatible = "gate-clock";
	clocks = <&sys_32k_ck>;
	bit-shift = <8>;
	reg = <0x4a307888 0x4>;
};
