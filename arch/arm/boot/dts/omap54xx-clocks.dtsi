/*
 * Device Tree Source for OMAP5 clock data
 *
 * Copyright (C) 2013 Texas Instruments, Inc.
 *
 * This program is free software; you can redistribute it and/or modify
 * it under the terms of the GNU General Public License version 2 as
 * published by the Free Software Foundation.
 */

pad_clks_src_ck: pad_clks_src_ck {
	#clock-cells = <0>;
	compatible = "fixed-clock";
	clock-frequency = <12000000>;
};

pad_clks_ck: pad_clks_ck@4a004108 {
	#clock-cells = <0>;
	compatible = "gate-clock";
	clocks = <&pad_clks_src_ck>;
	bit-shift = <8>;
	reg = <0x4a004108 0x4>;
};

secure_32k_clk_src_ck: secure_32k_clk_src_ck {
	#clock-cells = <0>;
	compatible = "fixed-clock";
	clock-frequency = <32768>;
};

slimbus_src_clk: slimbus_src_clk {
	#clock-cells = <0>;
	compatible = "fixed-clock";
	clock-frequency = <12000000>;
};

slimbus_clk: slimbus_clk@4a004108 {
	#clock-cells = <0>;
	compatible = "gate-clock";
	clocks = <&slimbus_src_clk>;
	bit-shift = <10>;
	reg = <0x4a004108 0x4>;
};

sys_32k_ck: sys_32k_ck {
	#clock-cells = <0>;
	compatible = "fixed-clock";
	clock-frequency = <32768>;
};

virt_12000000_ck: virt_12000000_ck {
	#clock-cells = <0>;
	compatible = "fixed-clock";
	clock-frequency = <12000000>;
};

virt_13000000_ck: virt_13000000_ck {
	#clock-cells = <0>;
	compatible = "fixed-clock";
	clock-frequency = <13000000>;
};

virt_16800000_ck: virt_16800000_ck {
	#clock-cells = <0>;
	compatible = "fixed-clock";
	clock-frequency = <16800000>;
};

virt_19200000_ck: virt_19200000_ck {
	#clock-cells = <0>;
	compatible = "fixed-clock";
	clock-frequency = <19200000>;
};

virt_26000000_ck: virt_26000000_ck {
	#clock-cells = <0>;
	compatible = "fixed-clock";
	clock-frequency = <26000000>;
};

virt_27000000_ck: virt_27000000_ck {
	#clock-cells = <0>;
	compatible = "fixed-clock";
	clock-frequency = <27000000>;
};

virt_38400000_ck: virt_38400000_ck {
	#clock-cells = <0>;
	compatible = "fixed-clock";
	clock-frequency = <38400000>;
};

sys_clkin: sys_clkin@4ae06110 {
	#clock-cells = <0>;
	compatible = "mux-clock";
	clocks = <&virt_12000000_ck>, <&virt_13000000_ck>, <&virt_16800000_ck>, <&virt_19200000_ck>, <&virt_26000000_ck>, <&virt_27000000_ck>, <&virt_38400000_ck>;
	reg = <0x4ae06110 0x4>;
	bit-mask = <0x7>;
	index-starts-at-one;
};

xclk60mhsp1_ck: xclk60mhsp1_ck {
	#clock-cells = <0>;
	compatible = "fixed-clock";
	clock-frequency = <60000000>;
};

xclk60mhsp2_ck: xclk60mhsp2_ck {
	#clock-cells = <0>;
	compatible = "fixed-clock";
	clock-frequency = <60000000>;
};

abe_dpll_bypass_clk_mux: abe_dpll_bypass_clk_mux@4ae06108 {
	#clock-cells = <0>;
	compatible = "mux-clock";
	clocks = <&sys_clkin>, <&sys_32k_ck>;
	reg = <0x4ae06108 0x4>;
	bit-mask = <0x1>;
};

abe_dpll_clk_mux: abe_dpll_clk_mux@4ae0610c {
	#clock-cells = <0>;
	compatible = "mux-clock";
	clocks = <&sys_clkin>, <&sys_32k_ck>;
	reg = <0x4ae0610c 0x4>;
	bit-mask = <0x1>;
};

dpll_abe_ck: dpll_abe_ck@4a0041e0 {
	#clock-cells = <0>;
	compatible = "ti,omap4-dpll-m4xen-clock";
	clocks = <&abe_dpll_clk_mux>, <&abe_dpll_bypass_clk_mux>;
	reg = <0x4a0041e0 0x4>, <0x4a0041e4 0x4>, <0x4a0041e8 0x4>, <0x4a0041ec 0x4>;
	reg-names = "control", "idlest", "autoidle", "mult-div1";
};

dpll_abe_x2_ck: dpll_abe_x2_ck {
	#clock-cells = <0>;
	compatible = "ti,omap4-dpll-x2-clock";
	clocks = <&dpll_abe_ck>;
};

dpll_abe_m2x2_ck: dpll_abe_m2x2_ck@4a0041f0 {
	#clock-cells = <0>;
	compatible = "ti,divider-clock";
	clocks = <&dpll_abe_x2_ck>;
	ti,autoidle-shift = <8>;
	reg = <0x4a0041f0 0x4>;
	bit-mask = <0x1f>;
	index-starts-at-one;
	ti,autoidle-low;
};

abe_24m_fclk: abe_24m_fclk {
	#clock-cells = <0>;
	compatible = "fixed-factor-clock";
	clocks = <&dpll_abe_m2x2_ck>;
	clock-mult = <1>;
	clock-div = <8>;
};

abe_clk: abe_clk@4a004108 {
	#clock-cells = <0>;
	compatible = "divider-clock";
	clocks = <&dpll_abe_m2x2_ck>;
	reg = <0x4a004108 0x4>;
	bit-mask = <0x3>;
	index-power-of-two;
};

abe_iclk: abe_iclk {
	#clock-cells = <0>;
	compatible = "fixed-factor-clock";
	clocks = <&abe_clk>;
	clock-mult = <1>;
	clock-div = <2>;
};

abe_lp_clk_div: abe_lp_clk_div {
	#clock-cells = <0>;
	compatible = "fixed-factor-clock";
	clocks = <&dpll_abe_m2x2_ck>;
	clock-mult = <1>;
	clock-div = <16>;
};

dpll_abe_m3x2_ck: dpll_abe_m3x2_ck@4a0041f4 {
	#clock-cells = <0>;
	compatible = "ti,divider-clock";
	clocks = <&dpll_abe_x2_ck>;
	ti,autoidle-shift = <8>;
	reg = <0x4a0041f4 0x4>;
	bit-mask = <0x1f>;
	index-starts-at-one;
	ti,autoidle-low;
};

dpll_core_ck: dpll_core_ck@4a004120 {
	#clock-cells = <0>;
	compatible = "ti,omap4-dpll-core-clock";
	clocks = <&sys_clkin>, <&dpll_abe_m3x2_ck>;
	reg = <0x4a004120 0x4>, <0x4a004124 0x4>, <0x4a004128 0x4>, <0x4a00412c 0x4>;
	reg-names = "control", "idlest", "autoidle", "mult-div1";
};

dpll_core_x2_ck: dpll_core_x2_ck {
	#clock-cells = <0>;
	compatible = "ti,omap4-dpll-x2-clock";
	clocks = <&dpll_core_ck>;
};

dpll_core_h21x2_ck: dpll_core_h21x2_ck@4a004150 {
	#clock-cells = <0>;
	compatible = "ti,divider-clock";
	clocks = <&dpll_core_x2_ck>;
	ti,autoidle-shift = <8>;
	reg = <0x4a004150 0x4>;
	bit-mask = <0x3f>;
	index-starts-at-one;
	ti,autoidle-low;
};

c2c_fclk: c2c_fclk {
	#clock-cells = <0>;
	compatible = "fixed-factor-clock";
	clocks = <&dpll_core_h21x2_ck>;
	clock-mult = <1>;
	clock-div = <1>;
};

c2c_iclk: c2c_iclk {
	#clock-cells = <0>;
	compatible = "fixed-factor-clock";
	clocks = <&c2c_fclk>;
	clock-mult = <1>;
	clock-div = <2>;
};

custefuse_sys_gfclk_div: custefuse_sys_gfclk_div {
	#clock-cells = <0>;
	compatible = "fixed-factor-clock";
	clocks = <&sys_clkin>;
	clock-mult = <1>;
	clock-div = <2>;
};

dpll_core_h11x2_ck: dpll_core_h11x2_ck@4a004138 {
	#clock-cells = <0>;
	compatible = "ti,divider-clock";
	clocks = <&dpll_core_x2_ck>;
	ti,autoidle-shift = <8>;
	reg = <0x4a004138 0x4>;
	bit-mask = <0x3f>;
	index-starts-at-one;
	ti,autoidle-low;
};

dpll_core_h12x2_ck: dpll_core_h12x2_ck@4a00413c {
	#clock-cells = <0>;
	compatible = "ti,divider-clock";
	clocks = <&dpll_core_x2_ck>;
	ti,autoidle-shift = <8>;
	reg = <0x4a00413c 0x4>;
	bit-mask = <0x3f>;
	index-starts-at-one;
	ti,autoidle-low;
};

dpll_core_h13x2_ck: dpll_core_h13x2_ck@4a004140 {
	#clock-cells = <0>;
	compatible = "ti,divider-clock";
	clocks = <&dpll_core_x2_ck>;
	ti,autoidle-shift = <8>;
	reg = <0x4a004140 0x4>;
	bit-mask = <0x3f>;
	index-starts-at-one;
	ti,autoidle-low;
};

dpll_core_h14x2_ck: dpll_core_h14x2_ck@4a004144 {
	#clock-cells = <0>;
	compatible = "ti,divider-clock";
	clocks = <&dpll_core_x2_ck>;
	ti,autoidle-shift = <8>;
	reg = <0x4a004144 0x4>;
	bit-mask = <0x3f>;
	index-starts-at-one;
	ti,autoidle-low;
};

dpll_core_h22x2_ck: dpll_core_h22x2_ck@4a004154 {
	#clock-cells = <0>;
	compatible = "ti,divider-clock";
	clocks = <&dpll_core_x2_ck>;
	ti,autoidle-shift = <8>;
	reg = <0x4a004154 0x4>;
	bit-mask = <0x3f>;
	index-starts-at-one;
	ti,autoidle-low;
};

dpll_core_h23x2_ck: dpll_core_h23x2_ck@4a004158 {
	#clock-cells = <0>;
	compatible = "ti,divider-clock";
	clocks = <&dpll_core_x2_ck>;
	ti,autoidle-shift = <8>;
	reg = <0x4a004158 0x4>;
	bit-mask = <0x3f>;
	index-starts-at-one;
	ti,autoidle-low;
};

dpll_core_h24x2_ck: dpll_core_h24x2_ck@4a00415c {
	#clock-cells = <0>;
	compatible = "ti,divider-clock";
	clocks = <&dpll_core_x2_ck>;
	ti,autoidle-shift = <8>;
	reg = <0x4a00415c 0x4>;
	bit-mask = <0x3f>;
	index-starts-at-one;
	ti,autoidle-low;
};

dpll_core_m2_ck: dpll_core_m2_ck@4a004130 {
	#clock-cells = <0>;
	compatible = "ti,divider-clock";
	clocks = <&dpll_core_ck>;
	ti,autoidle-shift = <8>;
	reg = <0x4a004130 0x4>;
	bit-mask = <0x1f>;
	index-starts-at-one;
	ti,autoidle-low;
};

dpll_core_m3x2_ck: dpll_core_m3x2_ck@4a004134 {
	#clock-cells = <0>;
	compatible = "ti,divider-clock";
	clocks = <&dpll_core_x2_ck>;
	ti,autoidle-shift = <8>;
	reg = <0x4a004134 0x4>;
	bit-mask = <0x1f>;
	index-starts-at-one;
	ti,autoidle-low;
};

iva_dpll_hs_clk_div: iva_dpll_hs_clk_div {
	#clock-cells = <0>;
	compatible = "fixed-factor-clock";
	clocks = <&dpll_core_h12x2_ck>;
	clock-mult = <1>;
	clock-div = <1>;
};

dpll_iva_ck: dpll_iva_ck@4a0041a0 {
	#clock-cells = <0>;
	compatible = "ti,omap4-dpll-clock";
	clocks = <&sys_clkin>, <&iva_dpll_hs_clk_div>;
	reg = <0x4a0041a0 0x4>, <0x4a0041a4 0x4>, <0x4a0041a8 0x4>, <0x4a0041ac 0x4>;
	reg-names = "control", "idlest", "autoidle", "mult-div1";
};

dpll_iva_x2_ck: dpll_iva_x2_ck {
	#clock-cells = <0>;
	compatible = "ti,omap4-dpll-x2-clock";
	clocks = <&dpll_iva_ck>;
};

dpll_iva_h11x2_ck: dpll_iva_h11x2_ck@4a0041b8 {
	#clock-cells = <0>;
	compatible = "ti,divider-clock";
	clocks = <&dpll_iva_x2_ck>;
	ti,autoidle-shift = <8>;
	reg = <0x4a0041b8 0x4>;
	bit-mask = <0x3f>;
	index-starts-at-one;
	ti,autoidle-low;
};

dpll_iva_h12x2_ck: dpll_iva_h12x2_ck@4a0041bc {
	#clock-cells = <0>;
	compatible = "ti,divider-clock";
	clocks = <&dpll_iva_x2_ck>;
	ti,autoidle-shift = <8>;
	reg = <0x4a0041bc 0x4>;
	bit-mask = <0x3f>;
	index-starts-at-one;
	ti,autoidle-low;
};

mpu_dpll_hs_clk_div: mpu_dpll_hs_clk_div {
	#clock-cells = <0>;
	compatible = "fixed-factor-clock";
	clocks = <&dpll_core_h12x2_ck>;
	clock-mult = <1>;
	clock-div = <1>;
};

dpll_mpu_ck: dpll_mpu_ck@4a004160 {
	#clock-cells = <0>;
	compatible = "ti,omap4-dpll-clock";
	clocks = <&sys_clkin>, <&mpu_dpll_hs_clk_div>;
	reg = <0x4a004160 0x4>, <0x4a004164 0x4>, <0x4a004168 0x4>, <0x4a00416c 0x4>;
	reg-names = "control", "idlest", "autoidle", "mult-div1";
};

dpll_mpu_m2_ck: dpll_mpu_m2_ck@4a004170 {
	#clock-cells = <0>;
	compatible = "ti,divider-clock";
	clocks = <&dpll_mpu_ck>;
	ti,autoidle-shift = <8>;
	reg = <0x4a004170 0x4>;
	bit-mask = <0x1f>;
	index-starts-at-one;
	ti,autoidle-low;
};

per_dpll_hs_clk_div: per_dpll_hs_clk_div {
	#clock-cells = <0>;
	compatible = "fixed-factor-clock";
	clocks = <&dpll_abe_m3x2_ck>;
	clock-mult = <1>;
	clock-div = <2>;
};

dpll_per_ck: dpll_per_ck@4a008140 {
	#clock-cells = <0>;
	compatible = "ti,omap4-dpll-clock";
	clocks = <&sys_clkin>, <&per_dpll_hs_clk_div>;
	reg = <0x4a008140 0x4>, <0x4a008144 0x4>, <0x4a008148 0x4>, <0x4a00814c 0x4>;
	reg-names = "control", "idlest", "autoidle", "mult-div1";
};

dpll_per_x2_ck: dpll_per_x2_ck {
	#clock-cells = <0>;
	compatible = "ti,omap4-dpll-x2-clock";
	clocks = <&dpll_per_ck>;
};

dpll_per_h11x2_ck: dpll_per_h11x2_ck@4a008158 {
	#clock-cells = <0>;
	compatible = "ti,divider-clock";
	clocks = <&dpll_per_x2_ck>;
	ti,autoidle-shift = <8>;
	reg = <0x4a008158 0x4>;
	bit-mask = <0x3f>;
	index-starts-at-one;
	ti,autoidle-low;
};

dpll_per_h12x2_ck: dpll_per_h12x2_ck@4a00815c {
	#clock-cells = <0>;
	compatible = "ti,divider-clock";
	clocks = <&dpll_per_x2_ck>;
	ti,autoidle-shift = <8>;
	reg = <0x4a00815c 0x4>;
	bit-mask = <0x3f>;
	index-starts-at-one;
	ti,autoidle-low;
};

dpll_per_h14x2_ck: dpll_per_h14x2_ck@4a008164 {
	#clock-cells = <0>;
	compatible = "ti,divider-clock";
	clocks = <&dpll_per_x2_ck>;
	ti,autoidle-shift = <8>;
	reg = <0x4a008164 0x4>;
	bit-mask = <0x3f>;
	index-starts-at-one;
	ti,autoidle-low;
};

dpll_per_m2_ck: dpll_per_m2_ck@4a008150 {
	#clock-cells = <0>;
	compatible = "ti,divider-clock";
	clocks = <&dpll_per_ck>;
	ti,autoidle-shift = <8>;
	reg = <0x4a008150 0x4>;
	bit-mask = <0x1f>;
	index-starts-at-one;
	ti,autoidle-low;
};

dpll_per_m2x2_ck: dpll_per_m2x2_ck@4a008150 {
	#clock-cells = <0>;
	compatible = "ti,divider-clock";
	clocks = <&dpll_per_x2_ck>;
	ti,autoidle-shift = <8>;
	reg = <0x4a008150 0x4>;
	bit-mask = <0x1f>;
	index-starts-at-one;
	ti,autoidle-low;
};

dpll_per_m3x2_ck: dpll_per_m3x2_ck@4a008154 {
	#clock-cells = <0>;
	compatible = "ti,divider-clock";
	clocks = <&dpll_per_x2_ck>;
	ti,autoidle-shift = <8>;
	reg = <0x4a008154 0x4>;
	bit-mask = <0x1f>;
	index-starts-at-one;
	ti,autoidle-low;
};

dpll_unipro1_ck: dpll_unipro1_ck@4a008200 {
	#clock-cells = <0>;
	compatible = "ti,omap4-dpll-clock";
	clocks = <&sys_clkin>, <&sys_clkin>;
	reg = <0x4a008200 0x4>, <0x4a008204 0x4>, <0x4a008208 0x4>, <0x4a00820c 0x4>;
	reg-names = "control", "idlest", "autoidle", "mult-div1";
};

dpll_unipro1_clkdcoldo: dpll_unipro1_clkdcoldo {
	#clock-cells = <0>;
	compatible = "fixed-factor-clock";
	clocks = <&dpll_unipro1_ck>;
	clock-mult = <1>;
	clock-div = <1>;
};

dpll_unipro1_m2_ck: dpll_unipro1_m2_ck@4a008210 {
	#clock-cells = <0>;
	compatible = "ti,divider-clock";
	clocks = <&dpll_unipro1_ck>;
	ti,autoidle-shift = <8>;
	reg = <0x4a008210 0x4>;
	bit-mask = <0x7f>;
	index-starts-at-one;
	ti,autoidle-low;
};

dpll_unipro2_ck: dpll_unipro2_ck@4a0081c0 {
	#clock-cells = <0>;
	compatible = "ti,omap4-dpll-clock";
	clocks = <&sys_clkin>, <&sys_clkin>;
	reg = <0x4a0081c0 0x4>, <0x4a0081c4 0x4>, <0x4a0081c8 0x4>, <0x4a0081cc 0x4>;
	reg-names = "control", "idlest", "autoidle", "mult-div1";
};

dpll_unipro2_clkdcoldo: dpll_unipro2_clkdcoldo {
	#clock-cells = <0>;
	compatible = "fixed-factor-clock";
	clocks = <&dpll_unipro2_ck>;
	clock-mult = <1>;
	clock-div = <1>;
};

dpll_unipro2_m2_ck: dpll_unipro2_m2_ck@4a0081d0 {
	#clock-cells = <0>;
	compatible = "ti,divider-clock";
	clocks = <&dpll_unipro2_ck>;
	ti,autoidle-shift = <8>;
	reg = <0x4a0081d0 0x4>;
	bit-mask = <0x7f>;
	index-starts-at-one;
	ti,autoidle-low;
};

usb_dpll_hs_clk_div: usb_dpll_hs_clk_div {
	#clock-cells = <0>;
	compatible = "fixed-factor-clock";
	clocks = <&dpll_abe_m3x2_ck>;
	clock-mult = <1>;
	clock-div = <3>;
};

dpll_usb_ck: dpll_usb_ck@4a008180 {
	#clock-cells = <0>;
	compatible = "ti,omap4-dpll-j-type-clock";
	clocks = <&sys_clkin>, <&usb_dpll_hs_clk_div>;
	reg = <0x4a008180 0x4>, <0x4a008184 0x4>, <0x4a008188 0x4>, <0x4a00818c 0x4>;
	reg-names = "control", "idlest", "autoidle", "mult-div1";
};

dpll_usb_clkdcoldo: dpll_usb_clkdcoldo {
	#clock-cells = <0>;
	compatible = "fixed-factor-clock";
	clocks = <&dpll_usb_ck>;
	clock-mult = <1>;
	clock-div = <1>;
};

dpll_usb_m2_ck: dpll_usb_m2_ck@4a008190 {
	#clock-cells = <0>;
	compatible = "ti,divider-clock";
	clocks = <&dpll_usb_ck>;
	ti,autoidle-shift = <8>;
	reg = <0x4a008190 0x4>;
	bit-mask = <0x7f>;
	index-starts-at-one;
	ti,autoidle-low;
};

dss_syc_gfclk_div: dss_syc_gfclk_div {
	#clock-cells = <0>;
	compatible = "fixed-factor-clock";
	clocks = <&sys_clkin>;
	clock-mult = <1>;
	clock-div = <1>;
};

func_128m_clk: func_128m_clk {
	#clock-cells = <0>;
	compatible = "fixed-factor-clock";
	clocks = <&dpll_per_h11x2_ck>;
	clock-mult = <1>;
	clock-div = <2>;
};

func_12m_fclk: func_12m_fclk {
	#clock-cells = <0>;
	compatible = "fixed-factor-clock";
	clocks = <&dpll_per_m2x2_ck>;
	clock-mult = <1>;
	clock-div = <16>;
};

func_24m_clk: func_24m_clk {
	#clock-cells = <0>;
	compatible = "fixed-factor-clock";
	clocks = <&dpll_per_m2_ck>;
	clock-mult = <1>;
	clock-div = <4>;
};

func_48m_fclk: func_48m_fclk {
	#clock-cells = <0>;
	compatible = "fixed-factor-clock";
	clocks = <&dpll_per_m2x2_ck>;
	clock-mult = <1>;
	clock-div = <4>;
};

func_96m_fclk: func_96m_fclk {
	#clock-cells = <0>;
	compatible = "fixed-factor-clock";
	clocks = <&dpll_per_m2x2_ck>;
	clock-mult = <1>;
	clock-div = <2>;
};

l3_iclk_div: l3_iclk_div {
	#clock-cells = <0>;
	compatible = "fixed-factor-clock";
	clocks = <&dpll_core_h12x2_ck>;
	clock-mult = <1>;
	clock-div = <1>;
};

gpu_l3_iclk: gpu_l3_iclk {
	#clock-cells = <0>;
	compatible = "fixed-factor-clock";
	clocks = <&l3_iclk_div>;
	clock-mult = <1>;
	clock-div = <1>;
};

l3init_60m_fclk: l3init_60m_fclk@4a008104 {
	#clock-cells = <0>;
	compatible = "divider-clock";
	clocks = <&dpll_usb_m2_ck>;
	reg = <0x4a008104 0x4>;
	table = < 1 0 >, < 8 1 >;
	bit-mask = <0x1>;
};

wkupaon_iclk_mux: wkupaon_iclk_mux@4ae06108 {
	#clock-cells = <0>;
	compatible = "mux-clock";
	clocks = <&sys_clkin>, <&abe_lp_clk_div>;
	reg = <0x4ae06108 0x4>;
	bit-mask = <0x1>;
};

l3instr_ts_gclk_div: l3instr_ts_gclk_div {
	#clock-cells = <0>;
	compatible = "fixed-factor-clock";
	clocks = <&wkupaon_iclk_mux>;
	clock-mult = <1>;
	clock-div = <1>;
};

l4_root_clk_div: l4_root_clk_div {
	#clock-cells = <0>;
	compatible = "fixed-factor-clock";
	clocks = <&l3_iclk_div>;
	clock-mult = <1>;
	clock-div = <1>;
};

dss_32khz_clk: dss_32khz_clk@4a009420 {
	#clock-cells = <0>;
	compatible = "gate-clock";
	clocks = <&sys_32k_ck>;
	bit-shift = <11>;
	reg = <0x4a009420 0x4>;
};

dss_48mhz_clk: dss_48mhz_clk@4a009420 {
	#clock-cells = <0>;
	compatible = "gate-clock";
	clocks = <&func_48m_fclk>;
	bit-shift = <9>;
	reg = <0x4a009420 0x4>;
};

dss_dss_clk: dss_dss_clk@4a009420 {
	#clock-cells = <0>;
	compatible = "gate-clock";
	clocks = <&dpll_per_h12x2_ck>;
	bit-shift = <8>;
	reg = <0x4a009420 0x4>;
};

dss_sys_clk: dss_sys_clk@4a009420 {
	#clock-cells = <0>;
	compatible = "gate-clock";
	clocks = <&dss_syc_gfclk_div>;
	bit-shift = <10>;
	reg = <0x4a009420 0x4>;
};

gpio1_dbclk: gpio1_dbclk@4ae07938 {
	#clock-cells = <0>;
	compatible = "gate-clock";
	clocks = <&sys_32k_ck>;
	bit-shift = <8>;
	reg = <0x4ae07938 0x4>;
};

gpio2_dbclk: gpio2_dbclk@4a009060 {
	#clock-cells = <0>;
	compatible = "gate-clock";
	clocks = <&sys_32k_ck>;
	bit-shift = <8>;
	reg = <0x4a009060 0x4>;
};

gpio3_dbclk: gpio3_dbclk@4a009068 {
	#clock-cells = <0>;
	compatible = "gate-clock";
	clocks = <&sys_32k_ck>;
	bit-shift = <8>;
	reg = <0x4a009068 0x4>;
};

gpio4_dbclk: gpio4_dbclk@4a009070 {
	#clock-cells = <0>;
	compatible = "gate-clock";
	clocks = <&sys_32k_ck>;
	bit-shift = <8>;
	reg = <0x4a009070 0x4>;
};

gpio5_dbclk: gpio5_dbclk@4a009078 {
	#clock-cells = <0>;
	compatible = "gate-clock";
	clocks = <&sys_32k_ck>;
	bit-shift = <8>;
	reg = <0x4a009078 0x4>;
};

gpio6_dbclk: gpio6_dbclk@4a009080 {
	#clock-cells = <0>;
	compatible = "gate-clock";
	clocks = <&sys_32k_ck>;
	bit-shift = <8>;
	reg = <0x4a009080 0x4>;
};

gpio7_dbclk: gpio7_dbclk@4a009110 {
	#clock-cells = <0>;
	compatible = "gate-clock";
	clocks = <&sys_32k_ck>;
	bit-shift = <8>;
	reg = <0x4a009110 0x4>;
};

gpio8_dbclk: gpio8_dbclk@4a009118 {
	#clock-cells = <0>;
	compatible = "gate-clock";
	clocks = <&sys_32k_ck>;
	bit-shift = <8>;
	reg = <0x4a009118 0x4>;
};

iss_ctrlclk: iss_ctrlclk@4a009320 {
	#clock-cells = <0>;
	compatible = "gate-clock";
	clocks = <&func_96m_fclk>;
	bit-shift = <8>;
	reg = <0x4a009320 0x4>;
};

lli_txphy_clk: lli_txphy_clk@4a008f20 {
	#clock-cells = <0>;
	compatible = "gate-clock";
	clocks = <&dpll_unipro1_clkdcoldo>;
	bit-shift = <8>;
	reg = <0x4a008f20 0x4>;
};

lli_txphy_ls_clk: lli_txphy_ls_clk@4a008f20 {
	#clock-cells = <0>;
	compatible = "gate-clock";
	clocks = <&dpll_unipro1_m2_ck>;
	bit-shift = <9>;
	reg = <0x4a008f20 0x4>;
};

mmc1_32khz_clk: mmc1_32khz_clk@4a009628 {
	#clock-cells = <0>;
	compatible = "gate-clock";
	clocks = <&sys_32k_ck>;
	bit-shift = <8>;
	reg = <0x4a009628 0x4>;
};

sata_ref_clk: sata_ref_clk@4a009688 {
	#clock-cells = <0>;
	compatible = "gate-clock";
	clocks = <&sys_clkin>;
	bit-shift = <8>;
	reg = <0x4a009688 0x4>;
};

slimbus1_slimbus_clk: slimbus1_slimbus_clk@4a004560 {
	#clock-cells = <0>;
	compatible = "gate-clock";
	clocks = <&slimbus_clk>;
	bit-shift = <11>;
	reg = <0x4a004560 0x4>;
};

usb_host_hs_hsic480m_p1_clk: usb_host_hs_hsic480m_p1_clk@4a009658 {
	#clock-cells = <0>;
	compatible = "gate-clock";
	clocks = <&dpll_usb_m2_ck>;
	bit-shift = <13>;
	reg = <0x4a009658 0x4>;
};

usb_host_hs_hsic480m_p2_clk: usb_host_hs_hsic480m_p2_clk@4a009658 {
	#clock-cells = <0>;
	compatible = "gate-clock";
	clocks = <&dpll_usb_m2_ck>;
	bit-shift = <14>;
	reg = <0x4a009658 0x4>;
};

usb_host_hs_hsic480m_p3_clk: usb_host_hs_hsic480m_p3_clk@4a009658 {
	#clock-cells = <0>;
	compatible = "gate-clock";
	clocks = <&dpll_usb_m2_ck>;
	bit-shift = <7>;
	reg = <0x4a009658 0x4>;
};

usb_host_hs_hsic60m_p1_clk: usb_host_hs_hsic60m_p1_clk@4a009658 {
	#clock-cells = <0>;
	compatible = "gate-clock";
	clocks = <&l3init_60m_fclk>;
	bit-shift = <11>;
	reg = <0x4a009658 0x4>;
};

usb_host_hs_hsic60m_p2_clk: usb_host_hs_hsic60m_p2_clk@4a009658 {
	#clock-cells = <0>;
	compatible = "gate-clock";
	clocks = <&l3init_60m_fclk>;
	bit-shift = <12>;
	reg = <0x4a009658 0x4>;
};

usb_host_hs_hsic60m_p3_clk: usb_host_hs_hsic60m_p3_clk@4a009658 {
	#clock-cells = <0>;
	compatible = "gate-clock";
	clocks = <&l3init_60m_fclk>;
	bit-shift = <6>;
	reg = <0x4a009658 0x4>;
};

utmi_p1_gfclk: utmi_p1_gfclk@4a009658 {
	#clock-cells = <0>;
	compatible = "mux-clock";
	clocks = <&l3init_60m_fclk>, <&xclk60mhsp1_ck>;
	bit-shift = <24>;
	reg = <0x4a009658 0x4>;
	bit-mask = <0x1>;
};

usb_host_hs_utmi_p1_clk: usb_host_hs_utmi_p1_clk@4a009658 {
	#clock-cells = <0>;
	compatible = "gate-clock";
	clocks = <&utmi_p1_gfclk>;
	bit-shift = <8>;
	reg = <0x4a009658 0x4>;
};

utmi_p2_gfclk: utmi_p2_gfclk@4a009658 {
	#clock-cells = <0>;
	compatible = "mux-clock";
	clocks = <&l3init_60m_fclk>, <&xclk60mhsp2_ck>;
	bit-shift = <25>;
	reg = <0x4a009658 0x4>;
	bit-mask = <0x1>;
};

usb_host_hs_utmi_p2_clk: usb_host_hs_utmi_p2_clk@4a009658 {
	#clock-cells = <0>;
	compatible = "gate-clock";
	clocks = <&utmi_p2_gfclk>;
	bit-shift = <9>;
	reg = <0x4a009658 0x4>;
};

usb_host_hs_utmi_p3_clk: usb_host_hs_utmi_p3_clk@4a009658 {
	#clock-cells = <0>;
	compatible = "gate-clock";
	clocks = <&l3init_60m_fclk>;
	bit-shift = <10>;
	reg = <0x4a009658 0x4>;
};

usb_otg_ss_refclk960m: usb_otg_ss_refclk960m@4a0096f0 {
	#clock-cells = <0>;
	compatible = "gate-clock";
	clocks = <&dpll_usb_clkdcoldo>;
	bit-shift = <8>;
	reg = <0x4a0096f0 0x4>;
};

usb_phy_cm_clk32k: usb_phy_cm_clk32k@4a008640 {
	#clock-cells = <0>;
	compatible = "gate-clock";
	clocks = <&sys_32k_ck>;
	bit-shift = <8>;
	reg = <0x4a008640 0x4>;
};

usb_tll_hs_usb_ch0_clk: usb_tll_hs_usb_ch0_clk@4a009668 {
	#clock-cells = <0>;
	compatible = "gate-clock";
	clocks = <&l3init_60m_fclk>;
	bit-shift = <8>;
	reg = <0x4a009668 0x4>;
};

usb_tll_hs_usb_ch1_clk: usb_tll_hs_usb_ch1_clk@4a009668 {
	#clock-cells = <0>;
	compatible = "gate-clock";
	clocks = <&l3init_60m_fclk>;
	bit-shift = <9>;
	reg = <0x4a009668 0x4>;
};

usb_tll_hs_usb_ch2_clk: usb_tll_hs_usb_ch2_clk@4a009668 {
	#clock-cells = <0>;
	compatible = "gate-clock";
	clocks = <&l3init_60m_fclk>;
	bit-shift = <10>;
	reg = <0x4a009668 0x4>;
};

aess_fclk: aess_fclk@4a004528 {
	#clock-cells = <0>;
	compatible = "divider-clock";
	clocks = <&abe_clk>;
	bit-shift = <24>;
	reg = <0x4a004528 0x4>;
	bit-mask = <0x1>;
};

dmic_sync_mux_ck: dmic_sync_mux_ck@4a004538 {
	#clock-cells = <0>;
	compatible = "mux-clock";
	clocks = <&abe_24m_fclk>, <&dss_syc_gfclk_div>, <&func_24m_clk>;
	bit-shift = <26>;
	reg = <0x4a004538 0x4>;
	bit-mask = <0x3>;
};

dmic_gfclk: dmic_gfclk@4a004538 {
	#clock-cells = <0>;
	compatible = "mux-clock";
	clocks = <&dmic_sync_mux_ck>, <&pad_clks_ck>, <&slimbus_clk>;
	bit-shift = <24>;
	reg = <0x4a004538 0x4>;
	bit-mask = <0x3>;
};

fdif_fclk: fdif_fclk@4a009328 {
	#clock-cells = <0>;
	compatible = "divider-clock";
	clocks = <&dpll_per_h11x2_ck>;
	bit-shift = <24>;
	reg = <0x4a009328 0x4>;
	bit-mask = <0x1>;
};

gpu_core_gclk_mux: gpu_core_gclk_mux@4a009520 {
	#clock-cells = <0>;
	compatible = "mux-clock";
	clocks = <&dpll_core_h14x2_ck>, <&dpll_per_h14x2_ck>;
	bit-shift = <24>;
	reg = <0x4a009520 0x4>;
	bit-mask = <0x1>;
};

gpu_hyd_gclk_mux: gpu_hyd_gclk_mux@4a009520 {
	#clock-cells = <0>;
	compatible = "mux-clock";
	clocks = <&dpll_core_h14x2_ck>, <&dpll_per_h14x2_ck>;
	bit-shift = <25>;
	reg = <0x4a009520 0x4>;
	bit-mask = <0x1>;
};

hsi_fclk: hsi_fclk@4a009638 {
	#clock-cells = <0>;
	compatible = "divider-clock";
	clocks = <&dpll_per_m2x2_ck>;
	bit-shift = <24>;
	reg = <0x4a009638 0x4>;
	bit-mask = <0x1>;
};

mcasp_sync_mux_ck: mcasp_sync_mux_ck@4a004540 {
	#clock-cells = <0>;
	compatible = "mux-clock";
	clocks = <&abe_24m_fclk>, <&dss_syc_gfclk_div>, <&func_24m_clk>;
	bit-shift = <26>;
	reg = <0x4a004540 0x4>;
	bit-mask = <0x3>;
};

mcasp_gfclk: mcasp_gfclk@4a004540 {
	#clock-cells = <0>;
	compatible = "mux-clock";
	clocks = <&mcasp_sync_mux_ck>, <&pad_clks_ck>, <&slimbus_clk>;
	bit-shift = <24>;
	reg = <0x4a004540 0x4>;
	bit-mask = <0x3>;
};

mcbsp1_sync_mux_ck: mcbsp1_sync_mux_ck@4a004548 {
	#clock-cells = <0>;
	compatible = "mux-clock";
	clocks = <&abe_24m_fclk>, <&dss_syc_gfclk_div>, <&func_24m_clk>;
	bit-shift = <26>;
	reg = <0x4a004548 0x4>;
	bit-mask = <0x3>;
};

mcbsp1_gfclk: mcbsp1_gfclk@4a004548 {
	#clock-cells = <0>;
	compatible = "mux-clock";
	clocks = <&mcbsp1_sync_mux_ck>, <&pad_clks_ck>, <&slimbus_clk>;
	bit-shift = <24>;
	reg = <0x4a004548 0x4>;
	bit-mask = <0x3>;
};

mcbsp2_sync_mux_ck: mcbsp2_sync_mux_ck@4a004550 {
	#clock-cells = <0>;
	compatible = "mux-clock";
	clocks = <&abe_24m_fclk>, <&dss_syc_gfclk_div>, <&func_24m_clk>;
	bit-shift = <26>;
	reg = <0x4a004550 0x4>;
	bit-mask = <0x3>;
};

mcbsp2_gfclk: mcbsp2_gfclk@4a004550 {
	#clock-cells = <0>;
	compatible = "mux-clock";
	clocks = <&mcbsp2_sync_mux_ck>, <&pad_clks_ck>, <&slimbus_clk>;
	bit-shift = <24>;
	reg = <0x4a004550 0x4>;
	bit-mask = <0x3>;
};

mcbsp3_sync_mux_ck: mcbsp3_sync_mux_ck@4a004558 {
	#clock-cells = <0>;
	compatible = "mux-clock";
	clocks = <&abe_24m_fclk>, <&dss_syc_gfclk_div>, <&func_24m_clk>;
	bit-shift = <26>;
	reg = <0x4a004558 0x4>;
	bit-mask = <0x3>;
};

mcbsp3_gfclk: mcbsp3_gfclk@4a004558 {
	#clock-cells = <0>;
	compatible = "mux-clock";
	clocks = <&mcbsp3_sync_mux_ck>, <&pad_clks_ck>, <&slimbus_clk>;
	bit-shift = <24>;
	reg = <0x4a004558 0x4>;
	bit-mask = <0x3>;
};

mmc1_fclk_mux: mmc1_fclk_mux@4a009628 {
	#clock-cells = <0>;
	compatible = "mux-clock";
	clocks = <&func_128m_clk>, <&dpll_per_m2x2_ck>;
	bit-shift = <24>;
	reg = <0x4a009628 0x4>;
	bit-mask = <0x1>;
};

mmc1_fclk: mmc1_fclk@4a009628 {
	#clock-cells = <0>;
	compatible = "divider-clock";
	clocks = <&mmc1_fclk_mux>;
	bit-shift = <25>;
	reg = <0x4a009628 0x4>;
	bit-mask = <0x1>;
};

mmc2_fclk_mux: mmc2_fclk_mux@4a009630 {
	#clock-cells = <0>;
	compatible = "mux-clock";
	clocks = <&func_128m_clk>, <&dpll_per_m2x2_ck>;
	bit-shift = <24>;
	reg = <0x4a009630 0x4>;
	bit-mask = <0x1>;
};

mmc2_fclk: mmc2_fclk@4a009630 {
	#clock-cells = <0>;
	compatible = "divider-clock";
	clocks = <&mmc2_fclk_mux>;
	bit-shift = <25>;
	reg = <0x4a009630 0x4>;
	bit-mask = <0x1>;
};

timer10_gfclk_mux: timer10_gfclk_mux@4a009028 {
	#clock-cells = <0>;
	compatible = "mux-clock";
	clocks = <&sys_clkin>, <&sys_32k_ck>;
	bit-shift = <24>;
	reg = <0x4a009028 0x4>;
	bit-mask = <0x1>;
};

timer11_gfclk_mux: timer11_gfclk_mux@4a009030 {
	#clock-cells = <0>;
	compatible = "mux-clock";
	clocks = <&sys_clkin>, <&sys_32k_ck>;
	bit-shift = <24>;
	reg = <0x4a009030 0x4>;
	bit-mask = <0x1>;
};

timer1_gfclk_mux: timer1_gfclk_mux@4ae07940 {
	#clock-cells = <0>;
	compatible = "mux-clock";
	clocks = <&sys_clkin>, <&sys_32k_ck>;
	bit-shift = <24>;
	reg = <0x4ae07940 0x4>;
	bit-mask = <0x1>;
};

timer2_gfclk_mux: timer2_gfclk_mux@4a009038 {
	#clock-cells = <0>;
	compatible = "mux-clock";
	clocks = <&sys_clkin>, <&sys_32k_ck>;
	bit-shift = <24>;
	reg = <0x4a009038 0x4>;
	bit-mask = <0x1>;
};

timer3_gfclk_mux: timer3_gfclk_mux@4a009040 {
	#clock-cells = <0>;
	compatible = "mux-clock";
	clocks = <&sys_clkin>, <&sys_32k_ck>;
	bit-shift = <24>;
	reg = <0x4a009040 0x4>;
	bit-mask = <0x1>;
};

timer4_gfclk_mux: timer4_gfclk_mux@4a009048 {
	#clock-cells = <0>;
	compatible = "mux-clock";
	clocks = <&sys_clkin>, <&sys_32k_ck>;
	bit-shift = <24>;
	reg = <0x4a009048 0x4>;
	bit-mask = <0x1>;
};

timer5_gfclk_mux: timer5_gfclk_mux@4a004568 {
	#clock-cells = <0>;
	compatible = "mux-clock";
	clocks = <&dss_syc_gfclk_div>, <&sys_32k_ck>;
	bit-shift = <24>;
	reg = <0x4a004568 0x4>;
	bit-mask = <0x1>;
};

timer6_gfclk_mux: timer6_gfclk_mux@4a004570 {
	#clock-cells = <0>;
	compatible = "mux-clock";
	clocks = <&dss_syc_gfclk_div>, <&sys_32k_ck>;
	bit-shift = <24>;
	reg = <0x4a004570 0x4>;
	bit-mask = <0x1>;
};

timer7_gfclk_mux: timer7_gfclk_mux@4a004578 {
	#clock-cells = <0>;
	compatible = "mux-clock";
	clocks = <&dss_syc_gfclk_div>, <&sys_32k_ck>;
	bit-shift = <24>;
	reg = <0x4a004578 0x4>;
	bit-mask = <0x1>;
};

timer8_gfclk_mux: timer8_gfclk_mux@4a004580 {
	#clock-cells = <0>;
	compatible = "mux-clock";
	clocks = <&dss_syc_gfclk_div>, <&sys_32k_ck>;
	bit-shift = <24>;
	reg = <0x4a004580 0x4>;
	bit-mask = <0x1>;
};

timer9_gfclk_mux: timer9_gfclk_mux@4a009050 {
	#clock-cells = <0>;
	compatible = "mux-clock";
	clocks = <&sys_clkin>, <&sys_32k_ck>;
	bit-shift = <24>;
	reg = <0x4a009050 0x4>;
	bit-mask = <0x1>;
};

auxclk0_src_mux_ck: auxclk0_src_mux_ck@4ae0a310 {
	#clock-cells = <0>;
	compatible = "mux-clock";
	clocks = <&sys_clkin>, <&dpll_core_m3x2_ck>, <&dpll_per_m3x2_ck>;
	bit-shift = <1>;
	reg = <0x4ae0a310 0x4>;
	bit-mask = <0x3>;
};

auxclk0_src_ck: auxclk0_src_ck@4ae0a310 {
	#clock-cells = <0>;
	compatible = "gate-clock";
	clocks = <&auxclk0_src_mux_ck>;
	bit-shift = <8>;
	reg = <0x4ae0a310 0x4>;
};

auxclk0_ck: auxclk0_ck@4ae0a310 {
	#clock-cells = <0>;
	compatible = "divider-clock";
	clocks = <&auxclk0_src_ck>;
	bit-shift = <16>;
	reg = <0x4ae0a310 0x4>;
	bit-mask = <0xf>;
};

auxclk1_src_mux_ck: auxclk1_src_mux_ck@4ae0a314 {
	#clock-cells = <0>;
	compatible = "mux-clock";
	clocks = <&sys_clkin>, <&dpll_core_m3x2_ck>, <&dpll_per_m3x2_ck>;
	bit-shift = <1>;
	reg = <0x4ae0a314 0x4>;
	bit-mask = <0x3>;
};

auxclk1_src_ck: auxclk1_src_ck@4ae0a314 {
	#clock-cells = <0>;
	compatible = "gate-clock";
	clocks = <&auxclk1_src_mux_ck>;
	bit-shift = <8>;
	reg = <0x4ae0a314 0x4>;
};

auxclk1_ck: auxclk1_ck@4ae0a314 {
	#clock-cells = <0>;
	compatible = "divider-clock";
	clocks = <&auxclk1_src_ck>;
	bit-shift = <16>;
	reg = <0x4ae0a314 0x4>;
	bit-mask = <0xf>;
};

auxclk2_src_mux_ck: auxclk2_src_mux_ck@4ae0a318 {
	#clock-cells = <0>;
	compatible = "mux-clock";
	clocks = <&sys_clkin>, <&dpll_core_m3x2_ck>, <&dpll_per_m3x2_ck>;
	bit-shift = <1>;
	reg = <0x4ae0a318 0x4>;
	bit-mask = <0x3>;
};

auxclk2_src_ck: auxclk2_src_ck@4ae0a318 {
	#clock-cells = <0>;
	compatible = "gate-clock";
	clocks = <&auxclk2_src_mux_ck>;
	bit-shift = <8>;
	reg = <0x4ae0a318 0x4>;
};

auxclk2_ck: auxclk2_ck@4ae0a318 {
	#clock-cells = <0>;
	compatible = "divider-clock";
	clocks = <&auxclk2_src_ck>;
	bit-shift = <16>;
	reg = <0x4ae0a318 0x4>;
	bit-mask = <0xf>;
};

auxclk3_src_mux_ck: auxclk3_src_mux_ck@4ae0a31c {
	#clock-cells = <0>;
	compatible = "mux-clock";
	clocks = <&sys_clkin>, <&dpll_core_m3x2_ck>, <&dpll_per_m3x2_ck>;
	bit-shift = <1>;
	reg = <0x4ae0a31c 0x4>;
	bit-mask = <0x3>;
};

auxclk3_src_ck: auxclk3_src_ck@4ae0a31c {
	#clock-cells = <0>;
	compatible = "gate-clock";
	clocks = <&auxclk3_src_mux_ck>;
	bit-shift = <8>;
	reg = <0x4ae0a31c 0x4>;
};

auxclk3_ck: auxclk3_ck@4ae0a31c {
	#clock-cells = <0>;
	compatible = "divider-clock";
	clocks = <&auxclk3_src_ck>;
	bit-shift = <16>;
	reg = <0x4ae0a31c 0x4>;
	bit-mask = <0xf>;
};

auxclk4_src_mux_ck: auxclk4_src_mux_ck@4ae0a320 {
	#clock-cells = <0>;
	compatible = "mux-clock";
	clocks = <&sys_clkin>, <&dpll_core_m3x2_ck>, <&dpll_per_m3x2_ck>;
	bit-shift = <1>;
	reg = <0x4ae0a320 0x4>;
	bit-mask = <0x3>;
};

auxclk4_src_ck: auxclk4_src_ck@4ae0a320 {
	#clock-cells = <0>;
	compatible = "gate-clock";
	clocks = <&auxclk4_src_mux_ck>;
	bit-shift = <8>;
	reg = <0x4ae0a320 0x4>;
};

auxclk4_ck: auxclk4_ck@4ae0a320 {
	#clock-cells = <0>;
	compatible = "divider-clock";
	clocks = <&auxclk4_src_ck>;
	bit-shift = <16>;
	reg = <0x4ae0a320 0x4>;
	bit-mask = <0xf>;
};

auxclkreq0_ck: auxclkreq0_ck@4ae0a210 {
	#clock-cells = <0>;
	compatible = "mux-clock";
	clocks = <&auxclk0_ck>, <&auxclk1_ck>, <&auxclk2_ck>, <&auxclk3_ck>, <&auxclk4_ck>;
	bit-shift = <2>;
	reg = <0x4ae0a210 0x4>;
	bit-mask = <0x7>;
};

auxclkreq1_ck: auxclkreq1_ck@4ae0a214 {
	#clock-cells = <0>;
	compatible = "mux-clock";
	clocks = <&auxclk0_ck>, <&auxclk1_ck>, <&auxclk2_ck>, <&auxclk3_ck>, <&auxclk4_ck>;
	bit-shift = <2>;
	reg = <0x4ae0a214 0x4>;
	bit-mask = <0x7>;
};

auxclkreq2_ck: auxclkreq2_ck@4ae0a218 {
	#clock-cells = <0>;
	compatible = "mux-clock";
	clocks = <&auxclk0_ck>, <&auxclk1_ck>, <&auxclk2_ck>, <&auxclk3_ck>, <&auxclk4_ck>;
	bit-shift = <2>;
	reg = <0x4ae0a218 0x4>;
	bit-mask = <0x7>;
};

auxclkreq3_ck: auxclkreq3_ck@4ae0a21c {
	#clock-cells = <0>;
	compatible = "mux-clock";
	clocks = <&auxclk0_ck>, <&auxclk1_ck>, <&auxclk2_ck>, <&auxclk3_ck>, <&auxclk4_ck>;
	bit-shift = <2>;
	reg = <0x4ae0a21c 0x4>;
	bit-mask = <0x7>;
};
